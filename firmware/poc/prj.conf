## CMakeLists.txt
```
cmake_minimum_required(VERSION 3.20.0)
find_package(Zephyr REQUIRED HINTS $ENV{ZEPHYR_BASE})
project(gateway_poc VERSION 0.1.0 LANGUAGES C)

target_sources(app PRIVATE src/main.c src/diagnostics.c src/network.c)
target_compile_options(app PRIVATE -Wall -Wextra -Werror)
```

## Kconfig
```
mainmenu "Industrial Gateway PoC"

source "Kconfig.zephyr"

menu "PoC heartbeat"

config POC_DHCP
	bool "Obtain IPv4 configuration using DHCP"
	default y
	select NET_DHCPV4

config POC_LOCAL_IPV4
	string "Static board IPv4 address"
	default "192.0.2.2"
	depends on !POC_DHCP

config POC_NETMASK
	string "Static IPv4 netmask"
	default "255.255.255.0"
	depends on !POC_DHCP

config POC_GATEWAY
	string "Static gateway (0.0.0.0 for an isolated link)"
	default "0.0.0.0"
	depends on !POC_DHCP

config POC_DEST_IPV4
	string "Approved PC IPv4 destination (empty disables heartbeat transmission)"
	default ""
	help
	  Set explicitly to the receiver PC address. No address discovery or broadcast.

config POC_UDP_PORT
	int "Destination UDP port"
	range 1024 65535
	default 4242

config POC_SEND_INTERVAL_MS
	int "Heartbeat interval in milliseconds"
	range 100 60000
	default 2000

endmenu
```

## prj.conf
```kconfig
CONFIG_GPIO=y
CONFIG_SERIAL=y
CONFIG_CONSOLE=y
CONFIG_UART_CONSOLE=y
CONFIG_LOG=y
CONFIG_LOG_DEFAULT_LEVEL=3
CONFIG_MAIN_STACK_SIZE=2048

CONFIG_NETWORKING=y
CONFIG_NET_L2_ETHERNET=y
CONFIG_NET_IPV4=y
CONFIG_NET_IPV6=n
CONFIG_NET_UDP=y
CONFIG_NET_TCP=n
CONFIG_NET_SOCKETS=y
# Application configures addresses without a blocking net_config wait.
CONFIG_NET_CONFIG_SETTINGS=n
# TX is queued to the network stack; main never waits for driver transmission.
CONFIG_NET_TC_TX_COUNT=1
CONFIG_NET_MAX_CONTEXTS=2
CONFIG_NET_PKT_RX_COUNT=8
CONFIG_NET_PKT_TX_COUNT=8
CONFIG_NET_BUF_RX_COUNT=16
CONFIG_NET_BUF_TX_COUNT=16
CONFIG_POC_DHCP=y
# Destination is intentionally empty until the operator selects the PC.
CONFIG_POC_DEST_IPV4=""
```

## static.conf
```kconfig
# Example ONLY: isolated link, PC manually configured as 192.0.2.1/24.
# Applying this profile explicitly selects that test destination.
CONFIG_POC_DHCP=n
CONFIG_POC_LOCAL_IPV4="192.0.2.2"
CONFIG_POC_NETMASK="255.255.255.0"
CONFIG_POC_GATEWAY="0.0.0.0"
CONFIG_POC_DEST_IPV4="192.0.2.1"
```

## src/main.c
```c
#include "diagnostics.h"
#include "network.h"

#include <zephyr/kernel.h>
#include <zephyr/logging/log.h>

LOG_MODULE_REGISTER(poc_main, LOG_LEVEL_INF);

int main(void)
{
	int64_t next_alive = 0;
	bool network_ready;

	diagnostics_init();
	network_ready = poc_network_init() == 0;
	if (!network_ready) {
		LOG_ERR("Network setup failed; M0 heartbeat remains active");
	}
	for (;;) {
		int64_t now = k_uptime_get();

		if (now >= next_alive) {
			diagnostics_tick();
			next_alive = now + 1000;
		}
		if (network_ready) {
			poc_network_tick();
		}
		k_sleep(K_MSEC(100));
	}
	return 0;
}
```

## src/diagnostics.c
```c
#include "diagnostics.h"

#include <zephyr/drivers/gpio.h>
#include <zephyr/kernel.h>
#include <zephyr/logging/log.h>

LOG_MODULE_REGISTER(poc_diag, LOG_LEVEL_INF);

#if DT_NODE_HAS_STATUS(DT_ALIAS(led0), okay)
static const struct gpio_dt_spec led = GPIO_DT_SPEC_GET(DT_ALIAS(led0), gpios);
static bool led_ready;
#endif

void diagnostics_init(void)
{
	LOG_INF("%s v%s | board=%s", POC_APP_NAME, POC_APP_VERSION, CONFIG_BOARD);
#if DT_NODE_HAS_STATUS(DT_ALIAS(led0), okay)
	led_ready = gpio_is_ready_dt(&led) &&
		    gpio_pin_configure_dt(&led, GPIO_OUTPUT_INACTIVE) == 0;
	if (!led_ready) {
		LOG_WRN("Activity LED unavailable; console heartbeat remains active");
	}
#endif
}

void diagnostics_tick(void)
{
	LOG_INF("alive uptime_ms=%lld", (long long)k_uptime_get());
#if DT_NODE_HAS_STATUS(DT_ALIAS(led0), okay)
	if (led_ready && gpio_pin_toggle_dt(&led) != 0) {
		led_ready = false;
		LOG_WRN("Activity LED write failed");
	}
#endif
}
```

## src/diagnostics.h
```c
#ifndef POC_DIAGNOSTICS_H
#define POC_DIAGNOSTICS_H

#define POC_APP_NAME "Industrial Gateway PoC"
#define POC_APP_VERSION "0.1.0"

void diagnostics_init(void);
void diagnostics_tick(void);

#endif
```

## src/network.c
```c
#include "network.h"
#include "diagnostics.h"

#include <errno.h>
#include <stdint.h>
#include <string.h>
#include <zephyr/kernel.h>
#include <zephyr/logging/log.h>
#include <zephyr/net/net_if.h>
#include <zephyr/net/dhcpv4.h>
#include <zephyr/net/ethernet.h>
#include <zephyr/net/socket.h>
#include <zephyr/sys/printk.h>

LOG_MODULE_REGISTER(poc_net, LOG_LEVEL_INF);

static struct net_if *iface;
static struct sockaddr_in peer;
static int udp_socket = -1;
static bool destination_set;
static int last_state = -1;
static uint32_t sequence;
static int64_t next_send;
static uint32_t last_ipv4;

static void close_socket(void)
{
	if (udp_socket >= 0) {
		(void)zsock_close(udp_socket);
		udp_socket = -1;
	}
}

int poc_network_init(void)
{
	iface = net_if_get_first_by_type(&NET_L2_GET_NAME(ETHERNET));
	if (iface == NULL || !device_is_ready(net_if_get_device(iface))) {
		LOG_ERR("Ethernet device unavailable");
		iface = NULL;
		return -ENODEV;
	}

	if (CONFIG_POC_DEST_IPV4[0] != '\0') {
		uint32_t addr;

		if (zsock_inet_pton(AF_INET, CONFIG_POC_DEST_IPV4, &peer.sin_addr) != 1) {
			LOG_ERR("Invalid destination IPv4; transmission disabled");
			return -EINVAL;
		}
		addr = ntohl(peer.sin_addr.s_addr);
		if ((addr >> 24) == 0 || (addr >> 24) == 127 || (addr >> 24) >= 224) {
			LOG_ERR("Destination must be a unicast PC IPv4 address");
			return -EINVAL;
		}
		peer.sin_family = AF_INET;
		peer.sin_port = htons(CONFIG_POC_UDP_PORT);
		destination_set = true;
		LOG_INF("UDP destination %s:%d interval=%d ms", CONFIG_POC_DEST_IPV4,
			CONFIG_POC_UDP_PORT, CONFIG_POC_SEND_INTERVAL_MS);
	} else {
		LOG_WRN("UDP TX disabled: set CONFIG_POC_DEST_IPV4 to the receiver PC");
	}

#if defined(CONFIG_POC_DHCP)
	net_dhcpv4_start(iface);
	LOG_INF("DHCP started (no blocking lease wait)");
#else
	struct in_addr local, mask, gateway;

	if (zsock_inet_pton(AF_INET, CONFIG_POC_LOCAL_IPV4, &local) != 1 ||
	    zsock_inet_pton(AF_INET, CONFIG_POC_NETMASK, &mask) != 1 ||
	    zsock_inet_pton(AF_INET, CONFIG_POC_GATEWAY, &gateway) != 1 ||
	    net_if_ipv4_addr_add(iface, &local, NET_ADDR_MANUAL, 0) == NULL ||
	    !net_if_ipv4_set_netmask_by_addr(iface, &local, &mask)) {
		LOG_ERR("Static IPv4 configuration failed");
		return -EINVAL;
	}
	net_if_ipv4_set_gw(iface, &gateway);
	LOG_INF("Static IPv4 %s mask=%s gateway=%s", CONFIG_POC_LOCAL_IPV4,
		CONFIG_POC_NETMASK, CONFIG_POC_GATEWAY);
#endif
	return 0;
}

void poc_network_tick(void)
{
	struct in_addr *local;
	int state;
	int64_t now = k_uptime_get();

	if (iface == NULL) {
		return;
	}
	local = net_if_ipv4_get_global_addr(iface, NET_ADDR_PREFERRED);
	state = !net_if_is_carrier_ok(iface) ? 0 :
		(!net_if_is_up(iface) || local == NULL ? 1 : 2);
	if (state != last_state) {
		LOG_INF("Network: %s", state == 0 ? "link down" :
			(state == 1 ? "link up, waiting for IPv4" : "link up, IPv4 ready"));
		last_state = state;
	}
	if (state != 2) {
		close_socket();
		last_ipv4 = 0;
		return;
	}
	if (local->s_addr != last_ipv4) {
		char text[NET_IPV4_ADDR_LEN];

		close_socket();
		last_ipv4 = local->s_addr;
		LOG_INF("IPv4 address: %s", net_addr_ntop(AF_INET, local, text, sizeof(text)));
	}
	if (!destination_set || now < next_send) {
		return;
	}
	next_send = now + CONFIG_POC_SEND_INTERVAL_MS;
	if (net_ipv4_is_addr_bcast(iface, &peer.sin_addr)) {
		LOG_ERR("Refusing a subnet broadcast destination");
		return;
	}
	if (udp_socket < 0) {
		udp_socket = zsock_socket(AF_INET, SOCK_DGRAM, IPPROTO_UDP);
		if (udp_socket < 0) {
			LOG_WRN("socket failed errno=%d; will retry", errno);
			return;
		}
	}
	/* Diagnostic text only, unrelated to future RS-485 industrial framing.
	 * Increment per attempt: a successful send is local acceptance, not delivery.
	 */
	char message[128];
	uint32_t seq = sequence++;
	int length = snprintk(message, sizeof(message),
		"poc=gateway version=" POC_APP_VERSION " seq=%u uptime_ms=%lld\n",
		seq, (long long)now);

	if (length < 0 || (size_t)length >= sizeof(message)) {
		LOG_ERR("Heartbeat formatting exceeded the fixed buffer");
		return;
	}
	int sent = zsock_sendto(udp_socket, message, length, ZSOCK_MSG_DONTWAIT,
			       (const struct sockaddr *)&peer, sizeof(peer));

	if (sent != length) {
		LOG_WRN("UDP send seq=%u failed result=%d errno=%d", seq, sent, errno);
		close_socket();
	} else {
		LOG_INF("UDP seq=%u accepted locally (%d bytes); reception unconfirmed", seq, sent);
	}
}
```

## src/network.h
```c
#ifndef POC_NETWORK_H
#define POC_NETWORK_H

/* Called only by main; no waits for link, DHCP lease or packet delivery. */
int poc_network_init(void);
void poc_network_tick(void);

#endif
```
